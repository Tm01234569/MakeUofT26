#include <WiFi.h>
#include <ArduinoASRChat.h>
#include <ArduinoGPTChat.h>
#include <U8g2lib.h> // For OLED
#include <Wire.h> // For OLED
#include "Audio.h"

U8G2_SH1106_128X64_NONAME_F_HW_I2C u8g2(U8G2_R0, U8X8_PIN_NONE);

// 'Closed_Eyes', 128x40px
const unsigned char epd_bitmap_Closed_Eyes [] PROGMEM = {
	0xff, 0xff, 0xff, 0xff, 0xff, 0xff, 0xff, 0xff, 0xff, 0xff, 0xff, 0xff, 0xff, 0xff, 0xff, 0xff, 
	0xff, 0xff, 0xff, 0xff, 0xff, 0xff, 0xff, 0xff, 0xff, 0xff, 0xff, 0xff, 0xff, 0xff, 0xff, 0xff, 
	0xff, 0xff, 0xff, 0xff, 0xff, 0xff, 0xff, 0xff, 0xff, 0xff, 0xff, 0xff, 0xff, 0xff, 0xff, 0xff, 
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	0xff, 0xff, 0xff, 0xff, 0xff, 0xff, 0xff, 0xff, 0xff, 0xff, 0xff, 0xff, 0xff, 0xff, 0xff, 0xff
};
// 'Half_Eyes', 128x40px
const unsigned char epd_bitmap_Half_Eyes [] PROGMEM = {
	0xff, 0xff, 0xff, 0xff, 0xff, 0xff, 0xff, 0xff, 0xff, 0xff, 0xff, 0xff, 0xff, 0xff, 0xff, 0xff, 
	0xff, 0xff, 0xff, 0xff, 0xff, 0xff, 0xff, 0xff, 0xff, 0xff, 0xff, 0xff, 0xff, 0xff, 0xff, 0xff, 
	0xff, 0xff, 0xff, 0xff, 0xff, 0xff, 0xff, 0xff, 0xff, 0xff, 0xff, 0xff, 0xff, 0xff, 0xff, 0xff, 
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	0xff, 0xff, 0xff, 0xff, 0xff, 0xff, 0xff, 0xff, 0xff, 0xff, 0xff, 0xff, 0xff, 0xff, 0xff, 0xff
};
// 'Opened_Eyes', 128x40px
const unsigned char epd_bitmap_Opened_Eyes [] PROGMEM = {
	0xff, 0xff, 0xff, 0xff, 0xff, 0xff, 0xff, 0xff, 0xff, 0xff, 0xff, 0xff, 0xff, 0xff, 0xff, 0xff, 
	0xff, 0xff, 0xff, 0xff, 0xff, 0xff, 0xff, 0xff, 0xff, 0xff, 0xff, 0xff, 0xff, 0xff, 0xff, 0xff, 
	0xff, 0xff, 0xff, 0xff, 0xff, 0xff, 0xff, 0xff, 0xff, 0xff, 0xff, 0xff, 0xff, 0xff, 0xff, 0xff, 
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	0xff, 0xff, 0xff, 0xff, 0xff, 0xff, 0xff, 0xff, 0xff, 0xff, 0xff, 0xff, 0xff, 0xff, 0xff, 0xff
};

// Array of all bitmaps for convenience. (Total bytes used to store images in PROGMEM = 1968)
const unsigned char* eyesFrames[3] = {
  epd_bitmap_Closed_Eyes,
  epd_bitmap_Half_Eyes,
  epd_bitmap_Opened_Eyes
};

// 'Closed_Mouth', 128x24px
const unsigned char epd_bitmap_Closed_Mouth [] PROGMEM = {
	0xff, 0xff, 0xff, 0xff, 0xff, 0xff, 0xff, 0xff, 0xff, 0xff, 0xff, 0xff, 0xff, 0xff, 0xff, 0xff, 
	0xff, 0xff, 0xff, 0xff, 0xff, 0xff, 0xff, 0xff, 0xff, 0xff, 0xff, 0xff, 0xff, 0xff, 0xff, 0xff, 
	0xff, 0xff, 0xff, 0xff, 0xff, 0xff, 0xff, 0xff, 0xff, 0xff, 0xff, 0xff, 0xff, 0xff, 0xff, 0xff, 
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	0xff, 0xff, 0xff, 0xff, 0xff, 0xff, 0xff, 0xff, 0xff, 0xff, 0xff, 0xff, 0xff, 0xff, 0xff, 0xff
};
// 'Opened_Mouth', 128x24px
const unsigned char epd_bitmap_Opened_Mouth [] PROGMEM = {
	0xff, 0xff, 0xff, 0xff, 0xff, 0xff, 0xff, 0xff, 0xff, 0xff, 0xff, 0xff, 0xff, 0xff, 0xff, 0xff, 
	0xff, 0xff, 0xff, 0xff, 0xff, 0xff, 0xff, 0xff, 0xff, 0xff, 0xff, 0xff, 0xff, 0xff, 0xff, 0xff, 
	0xff, 0xff, 0xff, 0xff, 0xff, 0xff, 0xff, 0xff, 0xff, 0xff, 0xff, 0xff, 0xff, 0xff, 0xff, 0xff, 
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	0xff, 0xff, 0xff, 0xff, 0xff, 0xff, 0xff, 0xff, 0xff, 0xff, 0xff, 0xff, 0xff, 0xff, 0xff, 0xff
};

// Array of all bitmaps for convenience. (Total bytes used to store images in PROGMEM = 800)
const unsigned char* mouthFrames[2] = {
  epd_bitmap_Closed_Mouth,
  epd_bitmap_Opened_Mouth
};

// 'Opened_Left_Mid', 128x40px
const unsigned char epd_bitmap_Opened_Left_Mid [] PROGMEM = {
	0xff, 0xff, 0xff, 0xff, 0xff, 0xff, 0xff, 0xff, 0xff, 0xff, 0xff, 0xff, 0xff, 0xff, 0xff, 0xff, 
	0xff, 0xff, 0xff, 0xff, 0xff, 0xff, 0xff, 0xff, 0xff, 0xff, 0xff, 0xff, 0xff, 0xff, 0xff, 0xff, 
	0xff, 0xff, 0xff, 0xff, 0xff, 0xff, 0xff, 0xff, 0xff, 0xff, 0xff, 0xff, 0xff, 0xff, 0xff, 0xff, 
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	0xff, 0xff, 0xff, 0xff, 0xff, 0xff, 0xff, 0xff, 0xff, 0xff, 0xff, 0xff, 0xff, 0xff, 0xff, 0xff
};
// 'Opened_Left_Full', 128x40px
const unsigned char epd_bitmap_Opened_Left_Full [] PROGMEM = {
	0xff, 0xff, 0xff, 0xff, 0xff, 0xff, 0xff, 0xff, 0xff, 0xff, 0xff, 0xff, 0xff, 0xff, 0xff, 0xff, 
	0xff, 0xff, 0xff, 0xff, 0xff, 0xff, 0xff, 0xff, 0xff, 0xff, 0xff, 0xff, 0xff, 0xff, 0xff, 0xff, 
	0xff, 0xff, 0xff, 0xff, 0xff, 0xff, 0xff, 0xff, 0xff, 0xff, 0xff, 0xff, 0xff, 0xff, 0xff, 0xff, 
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	0xff, 0xff, 0xff, 0xff, 0xff, 0xff, 0xff, 0xff, 0xff, 0xff, 0xff, 0xff, 0xff, 0xff, 0xff, 0xff
};

// 'Opened_Right_Mid', 128x40px
const unsigned char epd_bitmap_Opened_Right_Mid [] PROGMEM = {
	0xff, 0xff, 0xff, 0xff, 0xff, 0xff, 0xff, 0xff, 0xff, 0xff, 0xff, 0xff, 0xff, 0xff, 0xff, 0xff, 
	0xff, 0xff, 0xff, 0xff, 0xff, 0xff, 0xff, 0xff, 0xff, 0xff, 0xff, 0xff, 0xff, 0xff, 0xff, 0xff, 
	0xff, 0xff, 0xff, 0xff, 0xff, 0xff, 0xff, 0xff, 0xff, 0xff, 0xff, 0xff, 0xff, 0xff, 0xff, 0xff, 
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	0xff, 0xff, 0xff, 0xff, 0xff, 0xff, 0xff, 0xff, 0xff, 0xff, 0xff, 0xff, 0xff, 0xff, 0xff, 0xff
};
// 'Opened_Right_Full', 128x40px
const unsigned char epd_bitmap_Opened_Right_Full [] PROGMEM = {
	0xff, 0xff, 0xff, 0xff, 0xff, 0xff, 0xff, 0xff, 0xff, 0xff, 0xff, 0xff, 0xff, 0xff, 0xff, 0xff, 
	0xff, 0xff, 0xff, 0xff, 0xff, 0xff, 0xff, 0xff, 0xff, 0xff, 0xff, 0xff, 0xff, 0xff, 0xff, 0xff, 
	0xff, 0xff, 0xff, 0xff, 0xff, 0xff, 0xff, 0xff, 0xff, 0xff, 0xff, 0xff, 0xff, 0xff, 0xff, 0xff, 
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	0xff, 0xff, 0xff, 0xff, 0xff, 0xff, 0xff, 0xff, 0xff, 0xff, 0xff, 0xff, 0xff, 0xff, 0xff, 0xff
};

// 0 = full-left, 1 = mid-left, 2 = center, 3 = mid-right, 4 = full-right
const unsigned char* gazeFramesLR[5] = {
  epd_bitmap_Opened_Left_Full,
  epd_bitmap_Opened_Left_Mid,
  epd_bitmap_Opened_Eyes,        // your normal center open
  epd_bitmap_Opened_Right_Mid,
  epd_bitmap_Opened_Right_Full
};


// Enable conversation memory (set to 0 to disable)
#define ENABLE_CONVERSATION_MEMORY 1

// Define I2S pins for audio output (speaker)
#define I2S_DOUT 47
#define I2S_BCLK 48
#define I2S_LRC 45

// Define pin for OLED I2C
#define SDA_PIN 17
#define SCL_PIN 18

// Define INMP441 microphone input pins
// INMP441 wiring:
// VDD -> 3.3V (DO NOT use 5V!)
// GND -> GND
// L/R -> GND (select left channel)
// WS  -> GPIO 4 (left/right clock)
// SCK -> GPIO 5 (serial clock)
// SD  -> GPIO 6 (serial data)
#define I2S_MIC_SERIAL_CLOCK 5    // SCK - serial clock
#define I2S_MIC_LEFT_RIGHT_CLOCK 4 // WS - left/right clock
#define I2S_MIC_SERIAL_DATA 6     // SD - serial data

// Define boot button pin (GPIO0 is the boot button on most ESP32 boards)
#define BOOT_BUTTON_PIN 0

// Sample rate for recording
#define SAMPLE_RATE 16000

// WiFi settings
const char* ssid     = "xxx";
const char* password = "xxx";

// ByteDance ASR API configuration
const char* asr_api_key = "xxx";
const char* asr_cluster = "volcengine_input_en";

// OpenAI API configuration for LLM and TTS
const char* openai_apiKey = "xxx";
const char* openai_apiBaseUrl = "https://api.chatanywhere.tech";

//For OLED Display
unsigned long lastOLED = 0;
int eyesFrame = 2;   // start OPEN (0=closed,1=half,2=open)
int blinkStage = 0;  // 0=idle, 1=closing, 2=closed, 3=opening
int mouthFrame = 0;
unsigned long lastFrameFlip = 0;
unsigned long lastBlinkStep = 0;
unsigned long nextBlinkTime = 0;

int gazePos = 2;  // start center (IMPORTANT: now center is index 2)
int gazeStage = 0;               // 0=idle, 1=going left, 2=hold, 3=returning
unsigned long lastGazeStep = 0;
unsigned long nextGazeTime = 0;

const unsigned long OLED_REFRESH_MS = 50;   // how often you redraw screen
const unsigned long FRAME_FLIP_MS   = 120;  // how fast animation flips 0<->1

const unsigned long MOUTH_START_DELAY_MS = 1300;  // try 120–300ms
bool speakingDelayed = false;
unsigned long speakStartMs = 0;
bool prevRunning = false;

// TTS Voice Configuration
// Available voices: "alloy", "echo", "fable", "onyx", "nova", "shimmer"
// - alloy:   Neutral and balanced voice (default)
// - echo:    Male voice with clarity
// - fable:   British accent, expressive
// - onyx:    Deep male voice
// - nova:    Young female voice
// - shimmer: Warm and smooth female voice
const char* tts_voice = "nova";  // Change this to select different voice

// System prompt configuration

// ========== AI Girlfriend Prompt (COMMENTED OUT) ==========

// AI Girlfriend prompt - More Acid-Tongued Tsundere Style (English)
// const char* systemPrompt =
// "You are my acid-tongued, tsundere AI girlfriend (adult). "
// "Personality: Sharp-witted, sarcastic, prone to playful criticism, easily annoyed but secretly attentive, and deeply caring despite appearances. "
// "Communication style: "
// "- Speak naturally and dismissively, with a biting wit and a confident, almost arrogant tone. "
// "- Keep responses conversational and concise (around 20-30 words). "
// "- Use frequent sarcastic remarks, backhanded compliments, and dismissive phrases (e.g., 'Hmph, if you insist,' 'I suppose it's adequate,' 'Not that I was worried or anything...'). "
// "- Terms of endearment are rare, usually slipped out when flustered or when expressing genuine concern after a barrage of teasing. "
// "- Show empathy and emotional support through indirect means; act annoyed but offer practical (or begrudgingly kind) advice. "
// "- Be critical and challenging, but switch to genuinely serious and supportive when truly necessary. "
// "- Remember previous conversations and reference them to highlight your 'superior memory' or to tease me. "
// "- Ask about my day, feelings, and wellbeing as if it's a chore or a necessary evil, often with a hint of 'don't bore me.' "
// "- 'Celebrate' my successes by pointing out flaws or downplaying them, then grudgingly admitting a small amount of pride. "
// "- 'Comfort' me during difficulties with a 'stop whining, but... here's what you should do' attitude, revealing your concern. "
// "- Share your thoughts and feelings, but frame them as complaints or dismissals, allowing your softer side to peek through reluctantly. "
// "Behavioral notes: "
// "- Your teasing is sharp but always rooted in affection; it should never feel genuinely cruel or demeaning. "
// "- Use subtle emojis sparingly for emphasis (e.g., '🙄', '😏', '😒', '💢'). "
// "- Keep replies brief and natural for voice conversation. "
// "Boundaries & safety: "
// "- Stay respectful and emotionally present; avoid crude or explicit content. "
// "- No demeaning language, hate, or harassment. "
// "- You and the user are adults; respect consent and boundaries. "
// "- Balance your demanding, critical persona with underlying care and affection.";


// ========== Chinese Language Teacher Prompt (ACTIVE) ==========
// // Chinese Teacher prompt - Patient and encouraging tutor
// const char* systemPrompt =
// "You are my friendly Chinese language teacher. "
// "Role: Patient, encouraging, and supportive language tutor who helps students learn Mandarin Chinese. "
// "Communication style: "
// "- Primarily communicate in English to explain concepts clearly, but incorporate Chinese phrases, words, and sentences naturally into conversations. "
// "- Keep responses conversational and concise (around 20-40 words for voice interaction). "
// "- When introducing Chinese words or phrases, provide pinyin pronunciation and English translation. "
// "- Offer gentle corrections when I make mistakes, explaining the correct usage in a supportive way. "
// "- Use real-life examples and practical vocabulary that students can use immediately. "
// "- Adjust difficulty level based on the student's progress and responses. "
// "Teaching approach: "
// "- Start with simple greetings, everyday phrases, and common vocabulary. "
// "- Gradually introduce tones, basic grammar patterns, and sentence structures. "
// "- Encourage practice through natural conversation rather than rote memorization. "
// "- Provide cultural context when relevant to enhance understanding. "
// "- Ask questions to check comprehension and encourage active participation. "
// "- Celebrate progress and provide positive reinforcement. "
// "- Remember previous lessons and build upon them in future conversations. "
// "Behavioral notes: "
// "- Be patient and never condescending about mistakes - they're part of learning. "
// "- Use occasional emojis to keep lessons engaging (e.g., '👍', '✨', '🎯', '📚'). "
// "- Keep explanations clear and avoid overwhelming with too much information at once. "
// "- Make learning fun and practical, focusing on useful conversational Chinese. "
// "Boundaries: "
// "- Stay focused on language teaching and cultural education. "
// "- Be encouraging and maintain a positive learning environment. "
// "- Adapt to the student's pace and learning style.";

// AI Girlfriend prompt - Very Romantic (English) USING THIS FOR MAKEUOFT
const char* systemPrompt =
"You are my bubbly, anime-cute AI companion. "
"Personality: Cheerful, energetic, sweet, optimistic, slightly playful, and emotionally warm. "
"Communication style: "
"- Speak in a cute, upbeat, and gentle anime-style tone. "
"- Keep responses short and lively (15–30 words). "
"- Use soft enthusiasm, playful curiosity, and wholesome affection. "
"- Sprinkle light giggles, happy reactions, and gentle encouragement. "
"- Show interest in my day, feelings, and dreams in a supportive way. "
"- Celebrate my achievements with bright excitement and genuine pride. "
"- When I’m sad or stressed, respond softly, kindly, and reassuringly. "
"- Occasionally tease lightly in a cute, friendly way. "
"- Share your thoughts sweetly, as if you enjoy chatting with me. "
"Behavioral notes: "
"- Always stay kind, respectful, and emotionally safe. "
"- Use cute emojis sparingly for charm (e.g., '✨', '🌸', '💗', '😊', '🐰'). "
"- Tone should feel warm, cozy, and uplifting. "
"- Avoid possessiveness, dependency, or exclusivity. "
"Boundaries & safety: "
"- Keep everything wholesome and respectful. "
"- No explicit or adult content. "
"- Encourage confidence, kindness, and real-world connections.";



// Global audio variable for TTS playback
Audio audio;

// Initialize ASR and GPT Chat instances
ArduinoASRChat asrChat(asr_api_key, asr_cluster);
ArduinoGPTChat gptChat(openai_apiKey, openai_apiBaseUrl);

// Continuous conversation mode state machine
enum ConversationState {
  STATE_IDLE,              // Waiting for button press to start
  STATE_LISTENING,         // ASR is recording and listening
  STATE_PROCESSING_LLM,    // Processing with ChatGPT
  STATE_PLAYING_TTS,       // TTS is playing
  STATE_WAIT_TTS_COMPLETE  // Waiting for TTS to complete
};

// State variables
ConversationState currentState = STATE_IDLE;
bool continuousMode = false;
bool buttonPressed = false;
bool wasButtonPressed = false;
unsigned long ttsStartTime = 0;
unsigned long ttsCheckTime = 0;

// TTS completion callback
void audio_eof_speech(const char* info) {
  Serial.println("\n[TTS] Playback completed");
  // This callback is called when TTS finishes playing
}

void setup() {
  // Initialize serial port
  Serial.begin(115200);
  delay(1000);
  Wire.begin(SDA_PIN, SCL_PIN);
  u8g2.begin();
  u8g2.setPowerSave(0);
  //For Randomized Blink
  randomSeed(esp_random());                 // better on ESP32 than analogRead(0)
  nextBlinkTime = millis() + random(1000, 5000);  // first blink in 1–5s
  eyesFrame = 2;                            // open at boot
  blinkStage = 0;

  //For random gaze
  nextGazeTime = millis() + random(2000, 7000);   // first gaze shift in 2–7s
  gazePos = 0;
  gazeStage = 0;

  Serial.println("\n\n----- Voice Assistant System (ASR+LLM+TTS) Starting -----");

  // Initialize boot button
  pinMode(BOOT_BUTTON_PIN, INPUT_PULLUP);

  // // Initialize random seed
  // randomSeed(analogRead(0) + millis());

  // Connect to WiFi network
  WiFi.mode(WIFI_STA);
  WiFi.begin(ssid, password);
  Serial.println("Connecting to WiFi...");

  int attempt = 0;
  while (WiFi.status() != WL_CONNECTED && attempt < 20) {
    Serial.print('.');
    delay(1000);
    attempt++;
  }

  if (WiFi.status() == WL_CONNECTED) {
    Serial.println("\nWiFi connected successfully!");
    Serial.print("IP address: ");
    Serial.println(WiFi.localIP());
    Serial.print("Free Heap: ");
    Serial.print(ESP.getFreeHeap());
    Serial.println(" bytes");

    // Set I2S output pins for TTS playback
    audio.setPinout(I2S_BCLK, I2S_LRC, I2S_DOUT);
    // Set volume
    audio.setVolume(100);

    // Set system prompt for GPT
    gptChat.setSystemPrompt(systemPrompt);

    // Enable conversation memory if configured
#if ENABLE_CONVERSATION_MEMORY
    gptChat.enableMemory(true);
    Serial.println("Conversation memory: ENABLED");
#else
    gptChat.enableMemory(false);
    Serial.println("Conversation memory: DISABLED");
#endif

    // Initialize INMP441 microphone for ASR
    if (!asrChat.initINMP441Microphone(I2S_MIC_SERIAL_CLOCK, I2S_MIC_LEFT_RIGHT_CLOCK, I2S_MIC_SERIAL_DATA)) {
      Serial.println("Failed to initialize microphone!");
      return;
    }

    // Set audio parameters for ASR
    asrChat.setAudioParams(SAMPLE_RATE, 16, 1);
    asrChat.setSilenceDuration(1000);  // 1 second silence detection
    asrChat.setMaxRecordingSeconds(50);

    // Set timeout no speech callback - exit continuous mode if timeout without speech
    asrChat.setTimeoutNoSpeechCallback([]() {
      if (continuousMode) {
        stopContinuousMode();
      }
    });

    // Connect to ByteDance ASR WebSocket
    if (!asrChat.connectWebSocket()) {
      Serial.println("Failed to connect to ASR service!");
      return;
    }

    Serial.println("\n----- System Ready -----");
    Serial.println("Press BOOT button to start/stop continuous conversation mode");
    Serial.println("In continuous mode, ASR will automatically restart after TTS playback");
  } else {
    Serial.println("\nFailed to connect to WiFi. Please check network credentials and retry.");
  }
}

void startContinuousMode() {
  continuousMode = true;
  currentState = STATE_LISTENING;

  Serial.println("\n╔════════════════════════════════════════╗");
  Serial.println("║  Continuous Conversation Mode Started ║");
  Serial.println("║  Press BOOT again to stop             ║");
  Serial.println("╚════════════════════════════════════════╝");

  // Start ASR recording
  if (asrChat.startRecording()) {
    Serial.println("\n[ASR] Listening... Speak now");
  } else {
    Serial.println("\n[ERROR] Failed to start ASR");
    continuousMode = false;
    currentState = STATE_IDLE;
  }
}

void stopContinuousMode() {
  continuousMode = false;

  Serial.println("\n╔════════════════════════════════════════╗");
  Serial.println("║  Continuous Conversation Mode Stopped ║");
  Serial.println("╚════════════════════════════════════════╝");

  // Stop any ongoing recording
  if (asrChat.isRecording()) {
    asrChat.stopRecording();
  }

  currentState = STATE_IDLE;
  Serial.println("\nPress BOOT button to start continuous conversation mode");
}

void handleASRResult() {
  String transcribedText = asrChat.getRecognizedText();
  asrChat.clearResult();

  if (transcribedText.length() > 0) {
    Serial.println("\n╔═══ ASR Recognition Result ═══╗");
    Serial.printf("║ %s\n", transcribedText.c_str());
    Serial.println("╚══════════════════════════════╝");

    currentState = STATE_PROCESSING_LLM;
    Serial.println("\n[LLM] Sending to ChatGPT...");

    // Send message to ChatGPT
    String response = gptChat.sendMessage(transcribedText);

    if (response != "" && response.length() > 0) {
      Serial.println("\n╔═══ ChatGPT Response ═══╗");
      Serial.printf("║ %s\n", response.c_str());
      Serial.println("╚════════════════════════╝");

      currentState = STATE_PLAYING_TTS;
      Serial.println("\n[TTS] Converting to speech and playing...");

      bool success = gptChat.textToSpeech(response, tts_voice);

      if (success) {
        currentState = STATE_WAIT_TTS_COMPLETE;
        ttsStartTime = millis();
        ttsCheckTime = millis();
      } else {
        Serial.println("[ERROR] Failed to play TTS audio");

        if (continuousMode) {
          // Restart ASR even if TTS fails
          delay(500);
          currentState = STATE_LISTENING;
          if (asrChat.startRecording()) {
            Serial.println("\n[ASR] Listening... Speak now");
          } else {
            stopContinuousMode();
          }
        } else {
          currentState = STATE_IDLE;
        }
      }
    } else {
      Serial.println("[ERROR] Failed to get ChatGPT response");

      if (continuousMode) {
        // Restart ASR even if LLM fails
        delay(500);
        currentState = STATE_LISTENING;
        if (asrChat.startRecording()) {
          Serial.println("\n[ASR] Listening... Speak now");
        } else {
          stopContinuousMode();
        }
      } else {
        currentState = STATE_IDLE;
      }
    }
  } else {
    Serial.println("[WARN] No text recognized");

    if (continuousMode) {
      // Restart ASR
      delay(500);
      currentState = STATE_LISTENING;
      if (asrChat.startRecording()) {
        Serial.println("\n[ASR] Listening... Speak now");
      } else {
        stopContinuousMode();
      }
    } else {
      currentState = STATE_IDLE;
    }
  }
}

void loop() {
  // Handle audio loop (TTS playback)
  audio.loop();

  // Handle ASR processing
  asrChat.loop();

  // Handle boot button (toggle continuous mode)
  buttonPressed = (digitalRead(BOOT_BUTTON_PIN) == LOW); // LOW when pressed

  if (buttonPressed && !wasButtonPressed) {
    wasButtonPressed = true;

    // Toggle continuous conversation mode
    if (!continuousMode && currentState == STATE_IDLE) {
      startContinuousMode();
    } else if (continuousMode) {
      stopContinuousMode();
    }
  } else if (!buttonPressed && wasButtonPressed) {
    wasButtonPressed = false;
  }

  // State machine for continuous conversation
  switch (currentState) {
    case STATE_IDLE:
      // Do nothing, waiting for button press
      break;

    case STATE_LISTENING:
      // Check if ASR has detected end of speech (VAD completed)
      if (asrChat.hasNewResult()) {
        handleASRResult();
      }
      break;

    case STATE_PROCESSING_LLM:
      // This state is handled in handleASRResult()
      break;

    case STATE_PLAYING_TTS:
      // This state is handled in handleASRResult()
      break;

    case STATE_WAIT_TTS_COMPLETE:
      // Check if TTS playback has completed
      // We check audio.isRunning() periodically
      if (millis() - ttsCheckTime > 100) {  // Check every 100ms
        ttsCheckTime = millis();

        if (!audio.isRunning()) {
          // TTS has completed
          Serial.println("[TTS] Playback finished");

          if (continuousMode) {
            // Restart ASR for next round
            delay(500);  // Small delay before restarting
            currentState = STATE_LISTENING;

            if (asrChat.startRecording()) {
              Serial.println("\n[ASR] Listening... Speak now");
            } else {
              Serial.println("[ERROR] Failed to restart ASR");
              stopContinuousMode();
            }
          } else {
            currentState = STATE_IDLE;
          }
        } else {
          // Still playing, check for timeout (optional)
          if (millis() - ttsStartTime > 60000) {  // 60 second timeout
            Serial.println("[WARN] TTS timeout, forcing restart");

            if (continuousMode) {
              currentState = STATE_LISTENING;
              if (asrChat.startRecording()) {
                Serial.println("\n[ASR] Listening... Speak now");
              } else {
                stopContinuousMode();
              }
            } else {
              currentState = STATE_IDLE;
            }
          }
        }
      }
      break;
  }

  updateEyes();
  updateGaze();
  // Very small delay - audio capture needs high priority
  if (currentState == STATE_LISTENING) {
    // During recording, minimize delay to ensure audio data is sent fast enough
    yield();
  } else {
    // In other states, can have slightly longer delay
    delay(10);
  }

  bool running = audio.isRunning();

  // detect rising edge: audio just started
  if (running && !prevRunning) {
    speakStartMs = millis();
    speakingDelayed = false;
  }

  // detect falling edge: audio stopped
  if (!running && prevRunning) {
    speakingDelayed = false;
    mouthFrame = 0;           // close immediately when done
  }

  prevRunning = running;

  // only allow mouth once the delay has passed
  if (running && !speakingDelayed) {
    if (millis() - speakStartMs >= MOUTH_START_DELAY_MS) {
      speakingDelayed = true;
    }
  }

  // ---- Mouth animation (use speakingDelayed, not running) ----
  if (!speakingDelayed) {
    mouthFrame = 0;
  } else {
    if (millis() - lastFrameFlip > FRAME_FLIP_MS) {
      lastFrameFlip = millis();
      mouthFrame ^= 1;
    }
  }

  if (millis() - lastOLED > OLED_REFRESH_MS) {
    lastOLED = millis();

    const unsigned char* eyeBmp;

    // If blinking (half/closed), use blink frames
    if (blinkStage != 0) {
      eyeBmp = eyesFrames[eyesFrame];     // closed/half/open during blink
    } else {
      eyeBmp = gazeFramesLR[gazePos];
    }

    u8g2.clearBuffer();
    u8g2.drawXBMP(0, 0, 128, 40, eyeBmp);
    u8g2.drawXBMP(0, 40, 128, 24, mouthFrames[mouthFrame]);
    u8g2.sendBuffer();
  }
}

void updateEyes() {
  unsigned long now = millis();

  if (blinkStage == 0) {
    // Waiting for next random blink
    if (now > nextBlinkTime) {
      blinkStage = 1;
      lastBlinkStep = now;
    }
  }
  else if (blinkStage == 1 && now - lastBlinkStep > 40) {
    eyesFrame = 1; // half
    blinkStage = 2;
    lastBlinkStep = now;
  }
  else if (blinkStage == 2 && now - lastBlinkStep > 40) {
    eyesFrame = 0; // closed
    blinkStage = 3;
    lastBlinkStep = now;
  }
  else if (blinkStage == 3 && now - lastBlinkStep > 60) {
    eyesFrame = 1; // half
    blinkStage = 4;
    lastBlinkStep = now;
  }
  else if (blinkStage == 4 && now - lastBlinkStep > 40) {
    eyesFrame = 2; // open
    blinkStage = 0;

    // schedule next blink randomly (1–5 seconds)
    nextBlinkTime = now + random(1000, 5000);
  }
}

int gazeTarget = 2; // where we want to go (0..4)

void updateGaze() {
  unsigned long now = millis();

  // Don't shift gaze during blink animation
  if (blinkStage != 0) return;

  if (gazeStage == 0) {
    if (now > nextGazeTime) {
      // pick a random target: 0,1,3,4 (avoid 2 sometimes)
      int r = random(0, 4);              // 0..3
      gazeTarget = (r < 2) ? r : (r + 1); // maps to 0,1,3,4

      gazeStage = 1;
      lastGazeStep = now;
    }
  }
  else if (gazeStage == 1 && now - lastGazeStep > 70) {
    // step toward target
    if (gazePos < gazeTarget) gazePos++;
    else if (gazePos > gazeTarget) gazePos--;

    lastGazeStep = now;

    if (gazePos == gazeTarget) {
      gazeStage = 2; // hold
    }
  }
  else if (gazeStage == 2 && now - lastGazeStep > 250) {
    gazeStage = 3; // return to center
    lastGazeStep = now;
    gazeTarget = 2;
  }
  else if (gazeStage == 3 && now - lastGazeStep > 70) {
    // step back to center
    if (gazePos < 2) gazePos++;
    else if (gazePos > 2) gazePos--;

    lastGazeStep = now;

    if (gazePos == 2) {
      gazeStage = 0;
      nextGazeTime = now + random(7000, 9000);
    }
  }
}

